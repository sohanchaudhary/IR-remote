## main/Kconfig.projbuild
```kconfig
menu "Example Configuration"
    choice EXAMPLE_IR_PROTOCOL
        prompt "Infrared Protocol"
        default EXAMPLE_IR_PROTOCOL_NEC
        help
            Choose the IR protocol used in the example.

        config EXAMPLE_IR_PROTOCOL_GREE
            bool "GREE"
            help
                GREE is a kind of Pulse Distance Protocol.
                It uses ASK modulation and pulse distance encoding with a carrier frequency of 38 kHz.

        config EXAMPLE_IR_PROTOCOL_SHARP
            bool "SHARP"
            help
                SHARP is a kind of Pulse Distance Protocol.
                It uses ASK modulation and pulse distance encoding with a carrier frequency of 38 kHz.

        config EXAMPLE_IR_PROTOCOL_NEC
            bool "NEC"
            help
                NEC is a kind of Pulse Distance Protocol.
                It uses ASK modulation and pulse distance encoding with a carrier frequency of 38 kHz.

        config EXAMPLE_IR_PROTOCOL_PANASONIC
            bool "PANASONIC"
            help
                PANASONIC is a kind of Pulse Distance Protocol.
                It uses ASK modulation and pulse distance encoding with a carrier frequency of 38 kHz.

        config EXAMPLE_IR_PROTOCOL_DISH
            bool "DISH"
            help
                DISH is a kind of Pulse Distance Protocol.
                It uses ASK modulation and pulse distance encoding with a carrier frequency of 38 kHz.

        config EXAMPLE_IR_PROTOCOL_RC5
            bool "RC5"
            help
                The RC5 protocol was introduced by Philips.
                It uses ASK modulation and Manchester encoding with carrier frequency fixed at 36 kHz.

        config EXAMPLE_IR_PROTOCOL_SAMSUNG
            bool "SAMSUNG"
            help
                SAMSUNG is a kind of Pulse Distance Protocol.
                It uses ASK modulation and pulse distance encoding with a carrier frequency of 38 kHz.       
        
        config EXAMPLE_IR_PROTOCOL_LGAC
            bool "LGAC"
            help
                The LGAC protocol was introduced by Philips.
                It uses ASK modulation and pulse distance encoding with a carrier frequency of 38 kHz.

        config EXAMPLE_IR_PROTOCOL_LGTV
            bool "LGTV"
            help
                LGTV is a kind of Pulse Distance Protocol.
                It uses ASK modulation and pulse distance encoding with a carrier frequency of 38 kHz.

        config EXAMPLE_IR_PROTOCOL_SONY_12
            bool "SONY_12"
            help
                SONY is a kind of Pulse Distance Protocol.
                It uses ASK modulation and pulse Width encoding with a carrier frequency of 38 kHz.
        
        config EXAMPLE_IR_PROTOCOL_SONY_15
            bool "SONY_15"
            help
                SONY is a kind of Pulse Distance Protocol.
                It uses ASK modulation and pulse Width encoding with a carrier frequency of 38 kHz.

        config EXAMPLE_IR_PROTOCOL_SONY_20
            bool "SONY_20"
            help
                SONY is a kind of Pulse Distance Protocol.
                It uses ASK modulation and pulse Width encoding with a carrier frequency of 38 kHz.

    endchoice

    config EXAMPLE_RMT_TX_GPIO
        int "RMT TX GPIO"
        default 18
        help
            Set the GPIO number used for transmitting the RMT signal.

    config EXAMPLE_RMT_RX_GPIO
        int "RMT RX GPIO"
        default 8
        help
            Set the GPIO number used for receiving the RMT signal.

    config EXAMPLE_RMT_TX_CHANNEL
        int "RMT TX Channel Number"
        default 0
        help
            Set the RMT TX channel number.

    config EXAMPLE_RMT_RX_CHANNEL
        int "RMT RX Channel Number"
        default 4 if IDF_TARGET_ESP32S3
        default 2
        help
            Set the RMT RX channel number.
endmenu
```
